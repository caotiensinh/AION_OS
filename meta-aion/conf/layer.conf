## meta-aion/conf/layer.conf
```bitbake
BBPATH .= ":${LAYERDIR}"
BBFILES += "${LAYERDIR}/recipes-*/*/*.bb ${LAYERDIR}/recipes-*/*/*.bbappend"
BBFILE_COLLECTIONS += "aion"
BBFILE_PATTERN_aion := "^${LAYERDIR}/"
BBFILE_PRIORITY_aion = "6"
LAYERDEPENDS_aion = "core"
LAYERSERIES_COMPAT_aion = "wrynose"
```
